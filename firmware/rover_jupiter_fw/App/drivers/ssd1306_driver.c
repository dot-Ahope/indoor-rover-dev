/**
 * @file ssd1306_driver.c
 * @brief SSD1306 OLED 텍스트 드라이버 구현 — ssd1306_driver.h 참조.
 *
 * 초기화 순서는 SSD1306 데이터시트 권장 순서(표시 끔 → 클럭·멀티플렉스·오프셋·시작줄 → 차지펌프 →
 * 주소 모드 → 세그먼트·COM 방향 → COM 핀 배치 → 대비 → 프리차지 → VCOMH → 표시 켬)를 따른다.
 * 128×32 와 128×64 의 차이는 멀티플렉스 비(0x1F / 0x3F)와 COM 핀 배치(0x02 / 0x12) 두 가지.
 */
#include "ssd1306_driver.h"

#include <string.h>

/* 5×7 ASCII 글꼴 (0x20~0x7E, 글자당 5 열, LSB = 위쪽 픽셀) — 널리 쓰이는 공개 5×7 표. */
static const uint8_t k_font5x7[95][5] = {
    {0x00,0x00,0x00,0x00,0x00}, {0x00,0x00,0x5F,0x00,0x00}, {0x00,0x07,0x00,0x07,0x00}, {0x14,0x7F,0x14,0x7F,0x14}, /* ' ' ! " # */
    {0x24,0x2A,0x7F,0x2A,0x12}, {0x23,0x13,0x08,0x64,0x62}, {0x36,0x49,0x55,0x22,0x50}, {0x00,0x05,0x03,0x00,0x00}, /* $ % & ' */
    {0x00,0x1C,0x22,0x41,0x00}, {0x00,0x41,0x22,0x1C,0x00}, {0x14,0x08,0x3E,0x08,0x14}, {0x08,0x08,0x3E,0x08,0x08}, /* ( ) * + */
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    {0x00,0x00,0x7F,0x00,0x00}, {0x00,0x41,0x36,0x08,0x00}, {0x10,0x08,0x08,0x10,0x08},                              /* | } ~ */
};

static I2C_HandleTypeDef *s_i2c = NULL;
static uint8_t s_addr = 0x3C;
static uint8_t s_height = 32;
static bool s_ok = false;
/* 프레임 버퍼: 페이지(8 픽셀 줄) 단위, 앞에 데이터 제어 바이트 0x40 한 칸을 둬 한 번에 보낸다 */
static uint8_t s_buf[1 + SSD1306_WIDTH * SSD1306_MAX_HEIGHT / 8];

static bool cmd(const uint8_t *c, uint16_t n)
{
    uint8_t b[8];
    if (n > sizeof(b) - 1) return false;
    b[0] = 0x00;   /* 제어 바이트: 이어지는 바이트 모두 명령 */
    memcpy(&b[1], c, n);
    return HAL_I2C_Master_Transmit(s_i2c, (uint16_t)(s_addr << 1), b, (uint16_t)(n + 1), 20) == HAL_OK;
}

bool ssd1306_init(I2C_HandleTypeDef *hi2c, uint8_t addr7, uint8_t height)
{
    s_i2c = hi2c; s_addr = addr7; s_height = (height == 64) ? 64 : 32; s_ok = false;
    if (HAL_I2C_IsDeviceReady(s_i2c, (uint16_t)(s_addr << 1), 3, 10) != HAL_OK) return false;
    const uint8_t mux = (uint8_t)(s_height - 1);          /* 0x1F(32) / 0x3F(64) */
    const uint8_t compins = (s_height == 64) ? 0x12 : 0x02;
    const uint8_t seq[][3] = {
        {0xAE, 0, 0},          /* 표시 끔 */
        {0xD5, 0x80, 0},       /* 클럭 분주·발진 */
        {0xA8, mux, 0},        /* 멀티플렉스 비 */
        {0xD3, 0x00, 0},       /* 표시 오프셋 0 */
        {0x40, 0, 0},          /* 시작 줄 0 */
        {0x8D, 0x14, 0},       /* 차지펌프 켬(내부 승압) */
        {0x20, 0x00, 0},       /* 가로 주소 모드 */
        {0xA1, 0, 0},          /* 세그먼트 반전(좌우) */
        {0xC8, 0, 0},          /* COM 역순(상하) */
        {0xDA, compins, 0},    /* COM 핀 배치 */
        {0x81, 0x8F, 0},       /* 대비 */
        {0xD9, 0xF1, 0},       /* 프리차지 */
        {0xDB, 0x40, 0},       /* VCOMH */
        {0xA4, 0, 0},          /* RAM 내용 표시 */
        {0xA6, 0, 0},          /* 정상(비반전) */
        {0xAF, 0, 0},          /* 표시 켬 */
    };
    const uint8_t len[] = {1, 2, 2, 2, 1, 2, 2, 1, 1, 2, 2, 2, 2, 1, 1, 1};
    for (unsigned i = 0; i < sizeof(len); i++) {
        if (!cmd(seq[i], len[i])) return false;
    }
    s_ok = true;
    ssd1306_clear();
    return ssd1306_flush();
}

bool ssd1306_ok(void) { return s_ok; }

void ssd1306_clear(void)
{
    memset(s_buf, 0, sizeof(s_buf));
}

void ssd1306_text(uint8_t line, uint8_t col, const char *s)
{
    if (line >= s_height / 8 || s == NULL) return;
    uint8_t *page = &s_buf[1 + (uint16_t)line * SSD1306_WIDTH];
    for (uint8_t c = col; *s && c < SSD1306_COLS; s++, c++) {
        char ch = *s;
        if (ch < 0x20 || ch > 0x7E) ch = '?';
        const uint8_t *g = k_font5x7[ch - 0x20];
        uint8_t *p = &page[c * 6];
        memcpy(p, g, 5);
        p[5] = 0x00;   /* 글자 사이 한 열 */
    }
}

bool ssd1306_flush(void)
{
    if (!s_ok) return false;
    const uint8_t win[] = {0x21, 0, SSD1306_WIDTH - 1, 0x22, 0, (uint8_t)(s_height / 8 - 1)};   /* 열·페이지 범위 = 전체 */
    if (!cmd(&win[0], 3) || !cmd(&win[3], 3)) { s_ok = false; return false; }
    s_buf[0] = 0x40;   /* 제어 바이트: 이어지는 바이트 모두 데이터 */
    const uint16_t n = (uint16_t)(1 + SSD1306_WIDTH * s_height / 8);
    if (HAL_I2C_Master_Transmit(s_i2c, (uint16_t)(s_addr << 1), s_buf, n, 200) != HAL_OK) { s_ok = false; return false; }
    return true;
}
